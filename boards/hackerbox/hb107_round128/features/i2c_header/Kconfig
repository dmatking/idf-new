## boards/hackerbox/hb107_round128/features/i2c_header/Kconfig
```kconfig
menu "I2C Header"

    config I2C_HEADER_PORT
        int "I2C port number"
        default 0
        range 0 1

    config I2C_HEADER_CLK_HZ
        int "Clock speed (Hz)"
        default 400000
        help
            Standard: 100000, Fast: 400000

endmenu
```

## boards/hackerbox/hb107_round128/features/tf_card/Kconfig
```kconfig
menu "TF Card (SD)"

    config TF_CARD_MOUNT_POINT
        string "Mount point"
        default "/sdcard"
        help
            VFS path where the SD card will be mounted.

    config TF_CARD_MAX_FILES
        int "Max open files"
        default 5
        range 1 20

endmenu
```

## boards/hackerbox/hb107_round128/features/uart_header/Kconfig
```kconfig
menu "UART Header"

    config UART_HEADER_PORT
        int "UART port number"
        default 1
        range 0 2

    config UART_HEADER_BAUD
        int "Baud rate"
        default 115200

endmenu
```

## boards/lilygo/t4s3_amoled_touch/sdkconfig.defaults
```kconfig
CONFIG_IDF_TARGET="esp32s3"
CONFIG_SPIRAM=y
CONFIG_SPIRAM_MODE_OCT=y
CONFIG_SPIRAM_TYPE_AUTO=y
CONFIG_ESP_CONSOLE_USB_SERIAL_JTAG=y
CONFIG_ESP_DEFAULT_CPU_FREQ_MHZ_240=y
CONFIG_ESPTOOLPY_FLASHSIZE_16MB=y
```

## boards/waveshare/wvshr185_round/features/rtc/Kconfig
```kconfig
menu "RTC (PCF8563)"

    config RTC_I2C_PORT
        int "I2C port number"
        default 0
        range 0 1
        help
            Shared with IMU. Must match CONFIG_IMU_I2C_PORT if both features are used.

endmenu
```

## boards/waveshare/wvshr185_round/features/speaker/Kconfig
```kconfig
menu "Speaker (MAX98357A)"

    config SPEAKER_SAMPLE_RATE
        int "Sample rate (Hz)"
        default 16000
        help
            I2S sample rate for speaker output.

    config SPEAKER_BITS_PER_SAMPLE
        int "Bits per sample"
        default 16
        range 16 32
        help
            PCM bit depth. 16 is standard for most audio.

endmenu
```

## boards/waveshare/wvshr185_round/features/uart/Kconfig
```kconfig
menu "UART Header"

    config UART_HEADER_PORT
        int "UART port number"
        default 1
        range 0 2
        help
            UART peripheral number (0=UART0/console, 1 or 2 recommended).

    config UART_HEADER_BAUD
        int "Baud rate"
        default 115200
        help
            UART baud rate.

endmenu
```

## boards/waveshare/wvshr185_round_touch/features/imu/Kconfig
```kconfig
menu "IMU (QMI8658)"

    config IMU_I2C_PORT
        int "I2C port number"
        default 0
        range 0 1
        help
            Shared with RTC. Must match CONFIG_RTC_I2C_PORT if both features are used.

endmenu
```

## boards/waveshare/wvshr185_round_touch/features/mic/Kconfig
```kconfig
menu "Microphone (PDM)"

    config MIC_SAMPLE_RATE
        int "Sample rate (Hz)"
        default 16000
        help
            PDM microphone sample rate.

endmenu
```

## modules/gps/_common/Kconfig
```kconfig
menu "GPS Module"

    config GPS_UART_PORT
        int "UART port number"
        range 0 2
        default 1
        help
            UART peripheral to use for GPS communication (0, 1, or 2).

    config GPS_TX_PIN
        int "TX GPIO (ESP32 → GPS RX)"
        range -1 48
        default 17
        help
            GPIO connected to the GPS module's RX pin.
            Set to -1 to leave unconnected (receive-only mode).

    config GPS_RX_PIN
        int "RX GPIO (GPS TX → ESP32)"
        range 0 48
        default 3
        help
            GPIO connected to the GPS module's TX pin.

    config GPS_BAUD_RATE
        int "Baud rate"
        default 9600
        help
            Serial baud rate. Most NMEA GPS modules default to 9600.

endmenu
```
